&fpm {
	reg = <0x0 0x06000000 0x0 0x01000000>,	/* Free Pool 0	*/
	      <0x0 0xd3a00000 0x0 0x30133>;	/* Registers	*/
};

&runner {
	reg = <0x0 0xd5000000 0x0 0x000fc460>,	/* Registers			*/
	      <0x0 0x00000000 0x0 0x00000000>,	/* Runner Extra Memory 0	*/
	      <0x0 0x00000000 0x0 0x00000000>,	/* Runner Extra Memory 1	*/
	      <0x0 0x00000000 0x0 0x00000000>;	/* Runner NAT Cache		*/
};

&rsvd_rg_memc0 {
	reg = <0x0 0x02000000 0x0 0x03400000>, /* CM + leap */
	      <0x0 0x06000000 0x0 0x01000000>; /* FPM + cm extra */
};

&bassist {
	    tp1 = < 0x05000000 0x00400000 >; //start, size
	    cm_xfer = < 0x05000000 0x20000 0x2 >; //start, size, count
	    leap = < 0x04f00000 0x100000>; //start, size
	    arm_boot_rom = <0x05040000 0x00010000>; //start, size
	    cm_atw = < 0x0 0x02000000 0x02000000 0x0 0x4807FFFC 0x0 0x0 0x0 >; //index, start, size, destination, client0-3
	    cm_atw_extra = < 0x3 0x04000000 0x01000000 0x02000000 0x4807FFFC 0x0 0x0 0x0 >; //index, start, size, destination, client0-3
	    cm_dsp_atw = < 0x1 0x05000000 0x00400000 0x07c00000 0x4804FFFC 0x0 0x0 0x0 >; //index, start, size, destination, client0-3
	    cm_boot_atw = < 0x2 0x05050000 0x10000 0x1fc00000 0x40000 0x0 0x0 0x0 >; //index, start, size, destination, client0-3
	    cm_boot_atw_extra = < 0x4 0x04e00000 0x00200000 0x03e00000 0x40000 0x0 0x0 0x0 >; //index, start, size, destination, client0-3
};
